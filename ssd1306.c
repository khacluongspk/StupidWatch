/*
 * 
 * Driver SSD1306 for nRF51xxx
 * Author: Kachel
 * Data: Jun-06-2017
 * 
 */
#include <stdio.h>
#include <stdbool.h>
#include <stdlib.h>
#include <string.h>
#include "nrf_delay.h"
#include "nrf_gpio.h"
#include "nordic_common.h"
#include "ssd1306.h"
#include "app_error.h"
#include "nrf_delay.h"
#include "nrf_drv_twi.h"
#include "app_util_platform.h"


static uint8_t buffer[SSD1306_LCDHEIGHT * SSD1306_LCDWIDTH / 8] = {
        0x00, 0x00, 0x00, 0x00, 0x00, 0x00, 0x00, 0x00, 0x00, 0x00, 0x00, 0x00, 0x00, 0x00, 0x00, 0x00,
        0x00, 0x00, 0x00, 0x00, 0x00, 0x00, 0x00, 0x00, 0x00, 0x00, 0x00, 0x00, 0x00, 0x00, 0x00, 0x00,
        0x00, 0x00, 0x00, 0x00, 0x00, 0x00, 0x00, 0x00, 0x00, 0x00, 0x00, 0x00, 0x00, 0x00, 0x00, 0x00,
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        0x00, 0x00, 0x00, 0x00, 0x00, 0x00, 0x00, 0x00, 0x00, 0x00, 0x00, 0x00, 0x00, 0x00, 0x00, 0x00
};

const unsigned char BasicFont[][8] =
{
    {0x00,0x00,0x00,0x00,0x00,0x00,0x00,0x00},
    {0x00,0x00,0x5F,0x00,0x00,0x00,0x00,0x00},
    {0x00,0x00,0x07,0x00,0x07,0x00,0x00,0x00},
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    {0x00,0x02,0x05,0x05,0x02,0x00,0x00,0x00} 
};

const uint8_t smallNum[][22] = {
    //0
    {0xFE,0xFF,0xFF,0x0F,0x07,0x07,0x07,0x0F,0xFF,0xFF,0xFE,
    0x7F,0xFF,0xFF,0xF0,0xE0,0xE0,0xE0,0xF0,0xFF,0xFF,0x7F,},
    //1
    {0x00,0x00,0x18,0x1C,0x1E,0xFF,0xFF,0xFF,0x00,0x00,0x00,
    0x00,0x00,0x00,0x00,0x00,0xFF,0xFF,0xFF,0x00,0x00,0x00,},
    //2
    {0x1E,0x1F,0x1F,0x07,0x07,0x87,0xC7,0xE7,0xFF,0x7F,0x3E,
    0xF0,0xF8,0xFC,0xFE,0xEF,0xE7,0xE3,0xE1,0xE0,0xE0,0xE0,},
    //3
    {0x0E,0x0F,0x0F,0x07,0x07,0x87,0xC7,0xEF,0xFF,0x7F,0x3E,
    0x70,0xF0,0xF0,0xE0,0xE0,0xE1,0xE3,0xF7,0xFF,0xFE,0x7C,},
    //4
    {0xC0,0xE0,0xF0,0x78,0x3C,0x1E,0xFF,0xFF,0xFF,0x00,0x00,
    0x1F,0x1F,0x1F,0x1C,0x1C,0x1C,0xFF,0xFF,0xFF,0x1C,0x1C,},
    //5
    {0xFF,0xFF,0xFF,0xC7,0xC7,0xC7,0xC7,0xC7,0xC7,0x87,0x07,
    0x71,0xF1,0xF1,0xE1,0xE1,0xE1,0xE1,0xF3,0xFF,0x7F,0x3F,},
    //6
    {0xFE,0xFF,0xFF,0x8F,0x87,0x87,0x87,0x87,0x8F,0x8F,0x0E,
    0x7F,0xFF,0xFF,0xE3,0xE3,0xE3,0xE3,0xE3,0xFF,0xFF,0x7F,},
    //7
    {0x0F,0x0F,0x0F,0x07,0x07,0x07,0x87,0xC7,0xFF,0xFF,0x7F,
    0xE0,0xF0,0x78,0x3C,0x1E,0x0F,0x07,0x03,0x01,0x00,0x00,},
    //8
    {0x7E,0xFF,0xFF,0xC7,0x87,0x87,0x87,0xC7,0xFF,0xFF,0x7E,
    0x7E,0xFF,0xFF,0xE3,0xE1,0xE1,0xE1,0xE3,0xFF,0xFF,0x7E,},
    //9
    {0xFE,0xFF,0xFF,0xC7,0xC7,0xC7,0xC7,0xC7,0xFF,0xFF,0xFE,
    0x78,0xF9,0xF9,0xE1,0xE1,0xE1,0xE1,0xE1,0xFF,0xFF,0x7F,}
};

unsigned char WalkMan[][120] = {
    //step1
    {0x00, 0x00, 0x00, 0x00, 0x00, 0x00, 0x00, 0x00, 0xF0, 0xFC, 0xFC, 0xFE, 0xFE, 0xFE, 0xFE, 0xFE,
    0xFC, 0xF8, 0xC0, 0x00, 0x00, 0x00, 0x00, 0x00, 0x00, 0x00, 0x00, 0x00, 0x00, 0xC0, 0xE0, 0xF0,
    0xF9, 0xFF, 0xFF, 0xFF, 0xFF, 0xFF, 0xFF, 0xC7, 0x07, 0x03, 0x00, 0x00, 0x00, 0x00, 0x00, 0x00,
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    0x7C, 0x78, 0x38, 0x00, 0x00, 0x00, 0x00, 0x00, },
    //step2
    {0x00, 0x00, 0x00, 0x00, 0x00, 0x00, 0x00, 0x00, 0xF8, 0xFC, 0xFE, 0xFF, 0xFF, 0xFF, 0xFF, 0xFE,
    0xFE, 0xF8, 0x00, 0x00, 0x00, 0x00, 0x00, 0x00, 0x00, 0x00, 0x00, 0x00, 0x00, 0x00, 0x80, 0xE0,
    0xF0, 0xF9, 0xFF, 0xFF, 0xFF, 0xFF, 0x07, 0x07, 0x03, 0x01, 0x00, 0x00, 0x00, 0x00, 0x00, 0x00,
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    0x00, 0x00, 0x00, 0x00, 0x00, 0x00, 0x00, 0x00, },
    //step3
    {0x00, 0x00, 0x00, 0x00, 0x00, 0x00, 0x00, 0x00, 0xF8, 0xFC, 0xFE, 0xFE, 0xFE, 0xFE, 0xFE, 0xFE,
    0xFC, 0xF0, 0x00, 0x00, 0x00, 0x00, 0x00, 0x00, 0x00, 0x00, 0x00, 0x00, 0x00, 0x00, 0x80, 0xE0,
    0xF1, 0xFB, 0xFF, 0xFF, 0xFF, 0xFF, 0x8F, 0x07, 0x03, 0x01, 0x00, 0x00, 0x00, 0x00, 0x00, 0x00,
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    0x00, 0x00, 0x00, 0x00, 0x00, 0x00, 0x00, 0x00, },
    //step4
    {0x00, 0x00, 0x00, 0x00, 0x00, 0x00, 0x00, 0x00, 0x00, 0xF0, 0xFC, 0xFE, 0xFE, 0xFE, 0xFE, 0xFE,
    0xFE, 0xFC, 0xF8, 0x00, 0x00, 0x00, 0x00, 0x00, 0x00, 0x00, 0x00, 0x00, 0x00, 0x00, 0x00, 0xC0,
    0xE0, 0xF9, 0xFF, 0xFF, 0xFF, 0xFF, 0xFF, 0xEF, 0x07, 0x03, 0x01, 0x00, 0x00, 0x00, 0x00, 0x00,
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    0x7F, 0x78, 0x78, 0x30, 0x00, 0x00, 0x00, 0x00, },
    //step5
    {0x00, 0x00, 0x00, 0x00, 0x00, 0x00, 0x00, 0x00, 0xF8, 0xFC, 0xFE, 0xFF, 0xFF, 0xFF, 0xFF, 0xFE,
    0xFE, 0xF8, 0x00, 0x00, 0x00, 0x00, 0x00, 0x00, 0x00, 0x00, 0x00, 0x00, 0x00, 0x00, 0x80, 0xE0,
    0xF0, 0xF9, 0xFF, 0xFF, 0xFF, 0xFF, 0x07, 0x07, 0x03, 0x01, 0x00, 0x00, 0x00, 0x00, 0x00, 0x00,
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    0x00, 0x00, 0x00, 0x00, 0x00, 0x00, 0x00, 0x00, },
    //step6
    {0x00, 0x00, 0x00, 0x00, 0x00, 0x00, 0x00, 0x00, 0xF8, 0xFC, 0xFE, 0xFE, 0xFE, 0xFE, 0xFE, 0xFE,
    0xFC, 0xF0, 0x00, 0x00, 0x00, 0x00, 0x00, 0x00, 0x00, 0x00, 0x00, 0x00, 0x00, 0x00, 0x80, 0xE0,
    0xF1, 0xFB, 0xFF, 0xFF, 0xFF, 0xFF, 0x8F, 0x07, 0x03, 0x01, 0x00, 0x00, 0x00, 0x00, 0x00, 0x00,
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    0x00, 0x00, 0x00, 0x00, 0x00, 0x00, 0x00, 0x00, }
};


static const nrf_drv_twi_t m_twi = NRF_DRV_TWI_INSTANCE(1);
static uint16_t send_count =0;
static bool twi_evt_done = false;
void ssd1306_command(uint8_t c){
        ret_code_t ret;
        uint8_t dta_send[] = {0x00, c};
        ret = nrf_drv_twi_tx(&m_twi, SSD1306_I2C_ADDRESS, dta_send, 2, false);
        if (ret != 0) {
                printf("ssd1306 send command %02X failed err = %d\r\n", c, ret);
                nrf_delay_ms(10);
        } else {
                while (twi_evt_done != true);
                twi_evt_done = false;
        }
        UNUSED_VARIABLE(ret);
}

void ssd1306_data(uint8_t data){
        ret_code_t ret;
        uint8_t dta_send[] = {0x40, data};
        ret = nrf_drv_twi_tx(&m_twi, SSD1306_I2C_ADDRESS, dta_send, 2, false);
        if (ret != 0) {
                printf("ssd1306 send data %02X failed err = %d\r\n", data, ret);
                nrf_delay_ms(10);
        } else {
                while (twi_evt_done != true);
                twi_evt_done = false;
        }

        UNUSED_VARIABLE(ret);
}
void ssd1306_display(){
        ret_code_t ret;
        static uint8_t control = 0x40;
        uint16_t i;
        printf("ssd1306_display...");
        send_count = 0;
#if 0
        ssd1306_command(0xb0 | 0x0); // line #0
        ssd1306_command(0x00 | 0x0);  // low col = 0
        ssd1306_command(0x10 | 0x0);  // hi col = 0
#else
        ssd1306_command(SSD1306_COLUMNADDR);
        ssd1306_command(0);   // Column start address (0 = reset)
        ssd1306_command(SSD1306_LCDWIDTH - 1); // Column end address (127 = reset)

        ssd1306_command(SSD1306_PAGEADDR);
        ssd1306_command(0); // Page start address (0 = reset)
        ssd1306_command(7); // Page end address
#endif
        ret = nrf_drv_twi_tx(&m_twi, SSD1306_I2C_ADDRESS, &control, 1, true);
        if (ret != 0) {
                printf("ssd1306_display send buffer[%d] err = %d\r\n",i ,ret);
                nrf_delay_ms(10);
        } else {
                while (twi_evt_done != true);
                twi_evt_done = false;
        }
        for (i = 0; i < 1023; ++i)
        {
                ret = nrf_drv_twi_tx(&m_twi, SSD1306_I2C_ADDRESS, &buffer[i], 1, true);
                if (ret != 0) {
                        printf("ssd1306_display send buffer[%d] err = %d\r\n",i ,ret);
                        nrf_delay_ms(10);
                } else {
                        while (twi_evt_done != true);
                        twi_evt_done = false;
                }
        }
        ret = nrf_drv_twi_tx(&m_twi, SSD1306_I2C_ADDRESS, &buffer[1024], 1, false);
        if (ret != 0) {
                printf("ssd1306_display send buffer[%d] err = %d\r\n",i ,ret);
                nrf_delay_ms(10);
        } else {
                while (twi_evt_done != true);
                twi_evt_done = false;
        }
        printf(" done. send_count = %d \n\r",send_count);
}

void twi_handler(nrf_drv_twi_evt_t const * p_event, void * p_context)
{
        switch (p_event->type)
        {
                case NRF_DRV_TWI_EVT_DONE:
                        if (p_event->xfer_desc.type == NRF_DRV_TWI_XFER_TX)
                                send_count++;
                                twi_evt_done = true;
                        break;
                default:
                        break;
        }
}
void ssd1306_init(){
        ret_code_t err_code;
        const nrf_drv_twi_config_t twi_config = {
#if 1 
                .scl                = 0,
                .sda                = 1,
#else
                .scl                = 5,
                .sda                = 6,
#endif
                .frequency          = NRF_TWI_FREQ_100K,
                .interrupt_priority = APP_IRQ_PRIORITY_HIGH
        };

        err_code = nrf_drv_twi_init(&m_twi, &twi_config, twi_handler, NULL);
        APP_ERROR_CHECK(err_code);
        
        nrf_drv_twi_enable(&m_twi);
        APP_ERROR_CHECK(err_code);

        ssd1306_command(0xAE); //display off
        ssd1306_command(0x20); //Set Memory Addressing Mode   
        ssd1306_command(0x10); //00,Horizontal Addressing Mode;01,Vertical Addressing Mode;10,Page Addressing Mode (RESET);11,Invalid
        ssd1306_command(0xB0); //Set Page Start Address for Page Addressing Mode,0-7
        ssd1306_command(0xC8); //Set COM Output Scan Direction
        ssd1306_command(0x00); //---set low column address
        ssd1306_command(0x10); //---set high column address
        ssd1306_command(0x40); //--set start line address
        ssd1306_command(0x81); //--set contrast control register
        ssd1306_command(0xFF);
        ssd1306_command(0xA1); //--set segment re-map 0 to 127
        ssd1306_command(0xA6); //--set normal display
        ssd1306_command(0xA8); //--set multiplex ratio(1 to 64)
        ssd1306_command(0x3F); //
        ssd1306_command(0xA4); //0xa4,Output follows RAM content;0xa5,Output ignores RAM content
        ssd1306_command(0xD3); //-set display offset
        ssd1306_command(0x00); //-not offset
        ssd1306_command(0xD5); //--set display clock divide ratio/oscillator frequency
        ssd1306_command(0xF0); //--set divide ratio
        ssd1306_command(0xD9); //--set pre-charge period
        ssd1306_command(0x22); //
        ssd1306_command(0xDA); //--set com pins hardware configuration
        ssd1306_command(0x12);
        ssd1306_command(0xDB); //--set vcomh
        ssd1306_command(0x20); //0x20,0.77xVcc
        ssd1306_command(0x8D); //--set DC-DC enable
        ssd1306_command(0x14); //
        ssd1306_command(0xAF); //--turn on SSD1306 panel
}


void ssd1306_clear() {
        ssd1306_command(0x21); // set column start/end
        ssd1306_command(0);
        ssd1306_command(127);
        
        ssd1306_command(0x22); // set page start/end
        ssd1306_command(0);
        ssd1306_command(7);

        for (int i = 0; i < 1024; i++) {
                ssd1306_data(0x00);
        }
}

void ssd1306_show(){
        ssd1306_command(0x21); // set column start/end
        ssd1306_command(0);
        ssd1306_command(127);
        
        ssd1306_command(0x22); // set page start/end
        ssd1306_command(0);
        ssd1306_command(7);

        for (int i = 0; i < 1024; i++) {
                ssd1306_data(buffer[i]);
        }
}

void  ssd1306_setXY(uint16_t x,uint16_t y)
{
        ssd1306_command(0xB0 + x);            //set page address
        ssd1306_command(0x00 + (8*y & 0x0F));  //set column lower address
        ssd1306_command(0x10 + ((8*y>>4)&0x0F));   //set column higher address
}


void ssd1306_putChar(unsigned char C)
{
        if(C < 32 || C > 127) //Ignore non-printable ASCII characters. This can be modified for multilingual font.
        {
        C=' '; //Space
        }   
        unsigned char i= 0;
        for(i=0;i<8;i++)
        {
             //read bytes from code memory
             ssd1306_data(BasicFont[C-32][i]); //font array starts at 0, ASCII starts at 32. Hence the translation
        }
}


void  ssd1306_putString(char *str)
{
        while(*str){
                ssd1306_putChar(*str);
                str++;
        }
}

void ssd1306_putNumber(long num)
{
        char num_buff[10] = "0000000000";
        char i =9;
        
        if (num == 0){
                ssd1306_putChar('0');
                return;
        } else if (num < 0){
                ssd1306_putChar('-');
                num = -num;
        }
        
        while (num > 0){
                num_buff[i] = num % 10 + '0';
                num = num /10;
                i--;
        }

        while (i < 10){
                i++;
                ssd1306_putChar(num_buff[i]);
        }
}


void ssd1306_drawBitmap(uint16_t x,uint16_t y, uint16_t width,uint16_t height, uint8_t *bmp)
{
    uint16_t count = 0;
    /*
    for (int i = 0; i < height; ++i){
        ssd1306_setXY(x,y+i);
        for (int j = 0; j < width; ++j){
            ssd1306_data(bmp[count]);
            count++;
        }
    }
    */
        for (int j = 0; j < 120; ++j){
            if(j%24 == 0){
                count++;
                ssd1306_setXY(x +count,y);
            }
            ssd1306_data(bmp[j]);
        }

}


void ssd1306_smallNumber(uint16_t x, uint16_t y, int16_t num){

    char num_buff[10] = "0000000000";
    char i =9;
    int j = 0;
    if (num == 0){
            ssd1306_setXY(x,y);
            for (int j = 0; j < 22; ++j){
            if(j%11 == 0){
                x++;
                ssd1306_setXY(x,y);
            }
            ssd1306_data(smallNum[0][j]);
            }
            return;
    }
    
    while (num > 0){
            num_buff[i] = num % 10;
            num = num /10;
            i--;
    }

    while (i < 9){
            i++;
            ssd1306_setXY(x,y);
            for ( j = 0; j < 22; ++j){
            if(j%11 == 0){
                x++;
                ssd1306_setXY(x,y);
            }
            ssd1306_data(smallNum[num_buff[i]][j]);
        }
            x-=2;
            y+=2;
    }
}


void UpdateUI(uint8_t step_status,uint16_t step_count)
{
    static uint8_t i = 0;
    if (step_status == 1 && i < 5)
        i++;
    else
        i = 0;
    ssd1306_setXY(0,0);
    ssd1306_drawBitmap(0, 0,5,24,WalkMan[i]);
    ssd1306_smallNumber(0,5,step_count);
}